## PetaLinux/project-spec/configs/rootfsconfigs/Kconfig.user
```kconfig
menu "user packages " 
config axi-dma  
	 bool "axi-dma"
	 help
	
config gpio-demo  
	 bool "gpio-demo"
	 help
	
config peekpoke  
	 bool "peekpoke"
	 help
	
endmenu
```
